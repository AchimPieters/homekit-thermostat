## main/Kconfig.projbuild
```kconfig
menu "ESP32 Thermostat"

config HOMEKIT_SETUP_CODE
        string "HomeKit Setup Code"
        default "343-10-202"
        help
					If you want to change the HomeKit Setup Code, you can do that here
					(Note:  you need to make a new QR-CODE To make it work)

config HOMEKIT_SETUP_ID
        string "HomeKit Setup ID"
        default "XY38"
        help
                If you want to change the HomeKit Setup ID, you can do that here (Note: you need to make a new QR-CODE To make it work)

config TEMPERATURE_POLL_PERIOD
        int "Temperature Poll Period"
        default 60000
        help
                How often should the temperature be measured (default 1 minute in milliseconds)

config THERMOSTAT_MIN_TEMP
        int "Min thermostat temperature"
        default 10
        help
          Min allowed temperature for thermostat (Homekit starts from 10 degrees Celsius)

config THERMOSTAT_MAX_TEMP
        int "Max thermostat temperature"
        default 38
        help
					Max allowed temperature for thermostat (Homekit allows up to 38 degrees Celsius)

config RELAY_PIN
        int "Relay Pin"
        default 3
        help
					ESP32 pin for connecting relay

config SHT40_I2C_SDA
        int "SHT-40 I2C SDA Pin"
        default 6
        help
					ESP32 pin for connecting I2C SDA of SHT40 sensor

config SHT40_I2C_SCL
        int "SHT-40 I2C SCL Pin"
        default 7
        help
					ESP32 pin for connecting I2C SCL of SHT40 sensor

config LCD_PIN_SCLK
        int "LCD SCLK Pin"
        default 11

config LCD_PIN_MISO
        int "LCD MISO Pin"
        default 21

config LCD_PIN_MOSI
        int "LCD MOSI Pin"
        default 13

config LCD_PIN_DC
        int "LCD DC Pin"
        default 2

config LCD_PIN_RST
        int "LCD Reset Pin"
        default 4

config LCD_PIN_CS
        int "LCD CS Pin"
        default 15

config LCD_PIN_LIGHT
        int "LCD Backlight Pin"
        default 5

config LCD_PIN_TOUCH_CS
        int "LCD Touch CS Pin"
        default 12

endmenu
```
